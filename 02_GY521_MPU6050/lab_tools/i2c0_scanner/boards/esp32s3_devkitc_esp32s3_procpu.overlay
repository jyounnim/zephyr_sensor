/*
 * Overlay for the I2C0 bus scanner tool.
 *
 * Only enables I2C0 with this series' standard SDA=GPIO8/SCL=GPIO9
 * pinctrl override - deliberately does NOT declare aht20/bmp280
 * devicetree nodes, since the whole point is to probe raw addresses
 * without any driver getting in the way.
 */

#include <dt-bindings/pinctrl/esp32s3-pinctrl.h>
#include <zephyr/dt-bindings/i2c/i2c.h>

&pinctrl {
	i2c0_default: i2c0_default {
		group1 {
			pinmux = <I2C0_SDA_GPIO8>, <I2C0_SCL_GPIO9>;
			bias-pull-up;
			drive-open-drain;
			output-high;
		};
	};
};

&i2c0 {
	status = "okay";
	clock-frequency = <I2C_BITRATE_STANDARD>;
};
